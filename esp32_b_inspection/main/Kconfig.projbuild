## esp32_b_inspection/main/Kconfig.projbuild
```kconfig
menu "Inspection Station"

config STATION_WIFI_SSID
    string "Wi-Fi SSID"
    default "CHANGE_ME"

config STATION_WIFI_PASSWORD
    string "Wi-Fi password"
    default "CHANGE_ME"

config STATION_GATEWAY_IPV4
    string "Gateway IPv4 address"
    default "192.168.137.1"

config STATION_GATEWAY_PORT
    int "Gateway TCP port"
    range 1 65535
    default 5001

endmenu
```
